## techpack/Kconfig
```kconfig
menu "Tech packages"

source "techpack/data/Kconfig"

menu "Camera packages"

config TECHPACK_CAMERA_XIAOMI
    bool "Xiaomi camera"
    help
      Xiaomi camera

config TECHPACK_CAMERA_XIAOMI_CAS
    bool "Xiaomi camera CAS"
    help
      Xiaomi camera CAS

config TECHPACK_CAMERA_XIAOMI_TABLET
    bool "Xiaomi camera tablet"
    help
      Xiaomi camera tablet

config SUPPORT_ELISH_REC
	bool "CONFIG_SUPPORT_ELISH_REC"
	default n
	help
	   Let the elish device run normally with third-party recovery.

endmenu

endmenu
```
